## boards/shields/levee/Kconfig.defconfig
```kconfig
if SHIELD_LEVEE_LEFT

config ZMK_KEYBOARD_NAME
    default "Levee"

config ZMK_SPLIT_ROLE_CENTRAL
    default y

endif # SHIELD_LEVEE_LEFT

if SHIELD_LEVEE_LEFT || SHIELD_LEVEE_RIGHT

config ZMK_SPLIT
    default y

endif # SHIELD_LEVEE_LEFT || SHIELD_LEVEE_RIGHT
```

## config/boards/shields/levee/Kconfig.shield
```kconfig
config SHIELD_LEVEE_LEFT
    def_bool $(shields_list_contains,levee_left)

config SHIELD_LEVEE_RIGHT
    def_bool $(shields_list_contains,levee_right)
```
